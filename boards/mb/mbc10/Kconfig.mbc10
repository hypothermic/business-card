## boards/mb/mbc10/Kconfig.mbc10
```kconfig
config BOARD_MBC10
	select SOC_NRF5340_CPUAPP_QKAA if BOARD_MBC10_NRF5340_CPUAPP
	select SOC_NRF5340_CPUAPP_QKAA if BOARD_MBC10_NRF5340_CPUAPP_NS
	select SOC_NRF5340_CPUNET_QKAA if BOARD_MBC10_NRF5340_CPUNET
```

## boards/mb/mbc10/board.yml
```yaml
board:
  name: mbc10
  vendor: mb
  socs:
  - name: nrf5340
    variants:
    - name: ns
      cpucluster: cpuapp
```

## boards/mb/mbc10/mbc10_nrf5340_cpuapp_defconfig
```kconfig
CONFIG_ARM_MPU=y
CONFIG_HW_STACK_PROTECTION=y

CONFIG_ARM_TRUSTZONE_M=y

CONFIG_BT_HCI=y
#CONFIG_HEAP_MEM_POOL_ADD_SIZE_BOARD=4096
```
