/dts-v1/;
#include <nordic/nrf5340_cpuapp_qkaa.dtsi>
#include "mbc10-pinctrl.dtsi"

/ {
	model = "Business Card v1.0 (CPUAPP)";
	compatible = "mb,mbc10-cpuapp";

	chosen {
		zephyr,sram = &sram0_image;
		zephyr,flash = &flash0;
		zephyr,code-partition = &slot0_partition;
		zephyr,sram-secure-partition = &sram0_s;
		zephyr,sram-non-secure-partition = &sram0_ns;
	};
};

#include "mbc10-cpuapp_partitioning.dtsi"
#include "mbc10-shared_sram.dtsi"
